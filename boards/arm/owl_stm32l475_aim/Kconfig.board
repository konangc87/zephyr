## boards/arm/owl_stm32l475_aim/Kconfig.board
```kconfig
# Discovery IoT L475 board configuration

# Copyright (c) 2017 Linaro Limited
# SPDX-License-Identifier: Apache-2.0

config BOARD_OWL_SMT32L475_AIM
	bool "Owl STM32L475 AIM Development Board"
	depends on SOC_STM32L475XX
```

## boards/arm/owl_stm32l475_aim/owl_stm32l475_aim_defconfig
```kconfig
# SPDX-License-Identifier: Apache-2.0

CONFIG_BOARD_OWL_SMT32L475_AIM=y
CONFIG_SOC_SERIES_STM32L4X=y
CONFIG_SOC_STM32L475XX=y

CONFIG_VL53L0X_RECONFIGURE_ADDRESS=y

# CONFIG_USB_DEVICE_STACK=y


# enable uart driver
CONFIG_SERIAL=y
CONFIG_UART_INTERRUPT_DRIVEN=y

# enable GPIO
CONFIG_GPIO=y

# enable clock
CONFIG_CLOCK_CONTROL=y

# console
CONFIG_SHELL=y
CONFIG_CONSOLE=y
CONFIG_UART_CONSOLE=y

CONFIG_MODEM=y

# enable MPU
CONFIG_ARM_MPU=y

# Enable HW stack protection
CONFIG_HW_STACK_PROTECTION=y

# enable pin controller
CONFIG_PINCTRL=y
```
